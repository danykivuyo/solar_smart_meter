//#include <avr/pgmspace.h>

int lcdPin = 8;
int lcdPushButton = 9;
unsigned long int screenTimer = 0;
unsigned long int screenOnTimer = millis();
bool lcdOn = true;
int i = 0;

#define LCD_COLUMN_NUMBER 128
#define LCD_LINE_NUMBER 64
#define LCD_COLUMN_OFFSET 0
#define LCD_LINE_OFFSET 0
#define LCD_DIS_CHINA_ROT 0
#define LCD_COMMAND_NUMBER 16
#define LCD_PAGE_NUMBER (LCD_LINE_NUMBER / 8)
#define IIC_SCK 22
#define IIC_SDA 21

//#define IIC_SCK A2
//#define IIC_SDA A3

void draw5x8(byte col, char b);

const unsigned char LCD_init_cmd[LCD_COMMAND_NUMBER] = {
  0xe2, // 软复位
  0x2c, // 升压步聚1
  0x2e, // 升压步聚2
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  0xa2, // 1/9 偏压比（bias）
#if (LCD_DIS_CHINA_ROT == 180)
  0xA1, // 列扫描顺序：从右到右
  0xc8, // 行扫描顺序：从下到上
#else
  0xA0, // 列扫描顺序：从左到右
  0xc0, // 行扫描顺序：从上到下
#endif

  0xa6, // 正显
  0x40, // 起始行：第一行开始
  0xaf, // 开显示
};
static const unsigned char font[] = {
  0x00, 0x00, 0x00, 0x00, 0x00,
  0x3E, 0x5B, 0x4F, 0x5B, 0x3E,
  0x3E, 0x6B, 0x4F, 0x6B, 0x3E,
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  0x00, 0x00, 0x00, 0x00, 0x00 // #255 NBSP
};

void delay_us(unsigned char time_us)
{
  unsigned char temp = 0;
  while (time_us--)
  {
    temp++;
    temp++;
    temp++;
    temp++;
    temp++;
  }
}
// 写入  最后将SDA拉高，以等待从设备产生应答
void IIC_write(unsigned char date)
{
  unsigned char i, temp;
  temp = date;

  for (i = 0; i < 8; i++)
  {
    digitalWrite(IIC_SCK, LOW);

    if ((temp & 0x80) == 0)
      digitalWrite(IIC_SDA, LOW);
    else
      digitalWrite(IIC_SDA, HIGH);
    temp = temp << 1;
    // 最少250ns延时
    digitalWrite(IIC_SCK, HIGH);
  }
  digitalWrite(IIC_SCK, LOW);
  digitalWrite(IIC_SDA, HIGH);
  digitalWrite(IIC_SCK, HIGH);
  // 不进行应答检测
  digitalWrite(IIC_SCK, LOW);
}
// 启动信号
// SCL在高电平期间，SDA由高电平向低电平的变化定义为启动信号
void IIC_start()
{
  digitalWrite(IIC_SDA, HIGH);
  digitalWrite(IIC_SCK, HIGH);
  // 所有操作结束释放SCL
  digitalWrite(IIC_SDA, LOW);
  digitalWrite(IIC_SCK, LOW);
  IIC_write(0x7E);
}

// 停止信号
// SCL在高电平期间，SDA由低电平向高电平的变化定义为停止信号
void IIC_stop()
{
  digitalWrite(IIC_SDA, LOW);
  digitalWrite(IIC_SCK, HIGH);
  digitalWrite(IIC_SDA, HIGH);
  digitalWrite(IIC_SCK, LOW);
  digitalWrite(IIC_SDA, LOW);
}

void LCD_send_cmd(unsigned char o_command)
{

  IIC_start();
  IIC_write(0x00);
  IIC_write(o_command);

  IIC_stop();
}
// 位逆序
unsigned char ReverseBits(unsigned char num)
{
  num = ((num & 0x0f) << 4) | ((num >> 4) & 0x0f);
  num = ((num & 0x33) << 2) | ((num >> 2) & 0x33);
  num = ((num & 0x55) << 1) | ((num >> 1) & 0x55);
  return num;
}

void LCD_send_data(unsigned char o_data)
{
  IIC_start();
  IIC_write(0x40);
  IIC_write(ReverseBits(o_data));

  IIC_stop();
}
void Column_set(unsigned char column)
{
  column = column + LCD_COLUMN_OFFSET;
  LCD_send_cmd(0x10 | (column >> 4));   // 设置列地址高位
  LCD_send_cmd(0x00 | (column & 0x0f)); // 设置列地址低位
}
void Line_set(unsigned char line)
{
  line = line + LCD_LINE_OFFSET;
  LCD_send_cmd(0x40 + line);
}
void Page_set(unsigned char page)
{
  LCD_send_cmd(0xb0 + page);
}
void LCD_clear(void)
{
  unsigned char page, column;
  for (page = 0; page < LCD_PAGE_NUMBER; page++)
  {
    Page_set(page);
    Column_set(0);
    for (column = 0; column < LCD_COLUMN_NUMBER; column++)
    {
      LCD_send_data(0x00);
    }
  }
}
void LCD_full(void)
{
  unsigned char page, column;
  for (page = 0; page < LCD_PAGE_NUMBER; page++) // page loop
  {
    Page_set(page);
    Column_set(0);
    for (column = 0; column < LCD_COLUMN_NUMBER; column++) // column loop
    {
      LCD_send_data(0xff);
    }
  }
}
void LCD_init(void)
{
  unsigned char i;
  for (i = 0; i < LCD_COMMAND_NUMBER; i++)
  {
    LCD_send_cmd(LCD_init_cmd[i]);
  }
}

void DrawStr(byte x, byte y, const char *c)
{
  Page_set(7 - y);
  int len = strlen(c);
  for (int i = 0; i < len; i++)
  {
    draw5x8((x + i) * 6, c[i]);
    // delay(200);
  }
}

void DrawInt(byte x, byte y, int num)
{
  char buffer[10]; // Adjust the buffer size as needed
  snprintf(buffer, sizeof(buffer), "%d", num);
  DrawStr(x, y, buffer);
}

void DrawFloat(byte x, byte y, float num, int decimalPlaces)
{
  char buffer[20]; // Adjust the buffer size as needed
  snprintf(buffer, sizeof(buffer), "%.*f", decimalPlaces, num);
  DrawStr(x, y, buffer);
}

void DrawBool(byte x, byte y, bool value)
{
  DrawStr(x, y, value ? "True" : "False");
}

void DrawLong(byte x, byte y, long num)
{
  char buffer[20]; // Adjust the buffer size as needed
  snprintf(buffer, sizeof(buffer), "%ld", num);
  DrawStr(x, y, buffer);
}

void ClearCharacters(byte x, byte y, byte length)
{
  Page_set(7 - y);
  for (int i = 0; i < length; i++)
  {
    draw5x8((x + i) * 6, ' '); // Replace the character with a space
  }
}

void draw5x8(byte col, char b)
{
  Column_set(col);
  for (int n = 0; n < 5; n++)
  {
    LCD_send_data(pgm_read_byte(&font[b * 5 + n]));
  }
}

void IO_init(void)
{
  pinMode(IIC_SCK, OUTPUT); // 设置数字脚为输出
  pinMode(IIC_SDA, OUTPUT); // 设置数字脚为输出dddd
  digitalWrite(IIC_SCK, LOW);
  digitalWrite(IIC_SDA, LOW);
}

void lcd_init()
{
  IO_init();
  LCD_init();
  LCD_full();
  delay(1000);
}

void updateScreen()
{
  // updating LCD
  if (millis() - screenTimer >= 1000)
  {
    DrawStr(1, 1, " SOLAR SMART METER ");
//    DrawStr(3, 3, "DDD");
    char flw[20];
    float flow = i;
    i++;
    dtostrf(flow, 2, 2, flw);
//    DrawStr(10, 3, flw);

//    DrawStr(3, 5, "Relay:");
    char uni[20];
    dtostrf(34.00, 2, 2, uni);
//    DrawStr(10, 5, uni);
    screenTimer = millis();
  }
}
